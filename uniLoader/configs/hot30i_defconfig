## uniLoader/configs/hot30i_defconfig
```kconfig
CONFIG_POSITION_INDEPENDENT=y
CONFIG_LINUX_KRNL_HEADER_IMG=y
CONFIG_UMS9230=y
CONFIG_INFINIX_HOT30I=y
CONFIG_TEXT_BASE=0x80080000
CONFIG_PAYLOAD_ENTRY=0xb7000000
CONFIG_RAMDISK_ENTRY=0xc7000000
```
